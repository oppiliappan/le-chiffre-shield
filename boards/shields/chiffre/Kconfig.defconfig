## boards/shields/chiffre/Kconfig.defconfig
```kconfig
# Copyright (c) 2021 The ZMK Contributors
# SPDX-License-Identifier: MIT

if SHIELD_CHIFFRE

config ZMK_KEYBOARD_NAME
    default "chiffre"

endif
```

## boards/shields/chiffre/Kconfig.shield
```kconfig
# Copyright (c) 2021 The ZMK Contributors
# SPDX-License-Identifier: MIT

config SHIELD_CHIFFRE
    def_bool $(shields_list_contains,chiffre)
```
